/*
 * ring.cpp — the 8-LED WS2812 ring around the encoder, as the pager's second
 * output channel.
 *
 * The screen says what happened. The ring says that something happened, from
 * across a room, without being read. That is the whole division of labour, and
 * it is why almost everything here is a *state* rather than a flash: while an
 * unread message exists the ring breathes in that message's colour, and it
 * keeps breathing until somebody acknowledges it.
 *
 *
 * RMT coexistence with the IR transmitter — the thing that had to be settled
 * ------------------------------------------------------------------------
 * ir.cpp already owns an RMT TX channel (rmtInit(PIN_IR_TX, RMT_TX_MODE,
 * RMT_MEM_NUM_BLOCKS_2, 1000000)), and WS2812 also wants one. The numbers, from
 * the SoC caps header the build actually compiles against
 * (framework-arduinoespressif32-libs/esp32s3/include/soc/esp32s3/include/soc/
 * soc_caps.h):
 *
 *   SOC_RMT_GROUPS                  1
 *   SOC_RMT_CHANNELS_PER_GROUP      8
 *   SOC_RMT_TX_CANDIDATES_PER_GROUP 4     <- only four of the eight can transmit
 *   SOC_RMT_MEM_WORDS_PER_CHANNEL   48    <- one "memory block" is 48 symbols
 *
 * A channel asking for N memory blocks takes its own block plus the blocks of
 * the N-1 TX channels after it, so IR's two blocks cost two of the four TX
 * candidates and leave two. That is what this file spends, and it means the
 * ESP32-S3's TX side is now fully committed: a third RMT TX consumer added
 * later will fail at rmtInit() rather than quietly steal a channel.
 *
 * The Arduino core's wrapper (cores/esp32/esp32-hal-rmt.c in arduino-esp32
 * 3.3.9) keys everything on the *pin*: rmtInit() allocates one rmt_obj_s per
 * pin, each with its own IDF channel handle from rmt_new_tx_channel(), its own
 * copy encoder, its own event group and its own mutex — RMT_MUTEX_LOCK() takes
 * busptr->g_rmt_objlocks, not a global. The only shared lock, g_rmt_block_lock,
 * is held across allocation and released before any transmission. So two pins
 * transmit concurrently with no interlock between them, and a ring refresh
 * cannot stall or corrupt a frame the IR channel is clocking out.
 *
 * FastLED was never a candidate, for the reason recorded in the reference
 * firmware for this same board (tembed-pager/firmware/platformio.ini): it
 * claims every RMT TX channel on the first show() and installs a non-shared RMT
 * interrupt handler, which on a board that also transmits IR is a collision by
 * construction.
 *
 * Adafruit NeoPixel was that reference's choice and it is the right one there —
 * but that firmware builds on espressif32@6.13.0 (arduino-esp32 2.x, IDF 4) and
 * this one builds on arduino-esp32 3.3.9 (IDF 5), and on IDF 5 NeoPixel 1.12.3
 * is no longer a driver at all. Its whole ESP32 path (esp.c, the HAS_ESP_IDF_5
 * branch) is:
 *
 *     rmtInit(pin, RMT_TX_MODE, RMT_MEM_NUM_BLOCKS_1, 10000000);
 *     ... pack numBytes*8 rmt_data_t on the stack ...
 *     rmtWrite(pin, led_data, numBytes * 8, RMT_WAIT_FOR_EVER);
 *
 * — the very core wrapper this file would call anyway. Adding the library would
 * buy nothing and cost three things: a blocking rmtWrite() that parks the loop
 * task for the length of the bit stream, a variable-length rmt_data_t array on
 * that task's stack (768 bytes here) rather than in .bss, and a second copy of
 * the pixel buffer. So the ring is driven through the same rmt* wrapper ir.cpp
 * uses, with rmtWriteAsync() instead — identical peripheral arrangement to the
 * proven reference, minus the blocking.
 *
 * Timings below are NeoPixel's, unchanged, because they are what is known to
 * work on this board's ring: a 10MHz channel, so one tick is 100ns.
 *
 *
 * Not blocking, and not glitching
 * -------------------------------
 * The 800kHz bit stream is generated by the peripheral, not the CPU: 192 bits
 * at 1.2us is about 230us of hardware transmission per frame, started by a
 * non-blocking rmtWriteAsync() and never waited on. loop() spends only the
 * encode — 192 iterations of two bitfield stores — and ring_poll() runs at most
 * once every RING_FRAME_MS, so the ring costs a bounded fraction of a
 * millisecond forty times a second and cannot delay ir_poll().
 *
 * Two guards keep the stream itself intact:
 *
 *   - the symbol buffer is not touched while the peripheral owns it. A frame is
 *     encoded only after rmtTransmitCompleted() says the previous one is done;
 *     otherwise the frame is dropped and retried on the next pass.
 *   - a frame is only sent when the composed pixels differ from the last ones
 *     actually accepted, so a still ring — the common case — puts nothing on
 *     the wire at all.
 *
 * With one memory block the copy encoder's refill interrupt would fire every 24
 * symbols (30us); two blocks halve that to every 48 (60us), which is the margin
 * that WiFi and AsyncTCP interrupt latency is being padded against — the same
 * reasoning, and the same choice, as ir.cpp's two blocks. If two blocks cannot
 * be had the init falls back to one rather than leaving the ring dark, and says
 * which it got.
 *
 * A glitched WS2812 frame is a wrong colour for 25ms and self-corrects on the
 * next one. That asymmetry is the point of the arrangement above: the failure
 * that must not happen is a glitched IR blast, and IR is on its own channel,
 * with its own memory, its own mutex and its own interrupt, untouched by any of
 * this.
 *
 *
 * Brightness, gamma and night
 * ---------------------------
 * ring_level() is where a colour becomes a drive value, and the order of the
 * three operations is deliberate:
 *
 *   1. the channel is scaled by the effect's envelope, in perceptual space —
 *      this is what a breath or a comet tail means;
 *   2. the result is gamma-encoded through ring_gamma[], because a WS2812's
 *      output is roughly linear in its PWM value while the eye is not. Without
 *      it a breath is a snap to full followed by a plateau, and at the bottom
 *      of the ramp every colour collapses towards grey;
 *   3. only then is the global cap applied, linearly. That keeps "50%" meaning
 *      half the drive current — a power cap with a predictable effect — rather
 *      than a second gamma curve multiplied into the first.
 *
 * The cap is runtime-settable over HTTP because its value is provisional by
 * design; 50 is a starting point to be dialled in against the actual room, not
 * a measurement.
 *
 * Night silence is absolute: inside the window the ring does not light, not
 * even for an unread critical, which already breathes on the (dim) screen.
 * Boundaries come from clock_local_time() and therefore from whatever POSIX TZ
 * string SPIFFS holds — this file knows no city and no offset, and must not
 * learn one. When the clock has never been set the ring stays lit: a node that
 * has not reached NTP is usually a freshly booted or offline one, and a pager
 * that goes dark because it lost the time is broken in the direction that loses
 * messages.
 *
 * The window is switched on and off from the menu as well as over HTTP, and
 * switching it off means emptying it — so on a device with no time entry of any
 * kind the hours would be gone for good. They are kept in a second, saved pair
 * instead; the night window section further down is the whole of that.
 */

/* --- Geometry and rates --- */

#define RING_LEDS         8
#define RING_BITS         (RING_LEDS * 3 * 8)

/* 40Hz. Fast enough that a breath has no visible steps and a comet head moves
   smoothly, slow enough that the RMT channel is busy under 1% of the time. */
#define RING_FRAME_MS     25

/* WS2812 bit cells at 100ns per tick, from Adafruit NeoPixel's IDF 5 path. */
#define RING_T0H          4
#define RING_T0L          8
#define RING_T1H          8
#define RING_T1L          4

/* The reset that latches a frame is the line sitting low between writes, which
   rmtSetEOT(LOW) guarantees; at RING_FRAME_MS apart that gap is four orders of
   magnitude longer than the ~50us the part needs, so no reset symbol is sent. */

/* --- Effect durations --- */

#define RING_COMET_MS     640    /* one lap, 80ms a pixel */
#define RING_COMET_TAIL   3
#define RING_WIPE_MS      560    /* fill, then fade */
#define RING_WIPE_FADE_MS 160
#define RING_KNOB_HOLD_MS 400    /* the dot lingers this long after the last detent */
#define RING_BREATHE_MS   4000   /* info and warn */
#define RING_BREATHE_CRIT_MS 2000 /* matches the clock face's rule breathe */

/* The breath's floor, in envelope units before gamma. Zero would make the ring
   vanish at the bottom of every cycle, and "you have messages" must not blink
   out of existence — this is a faint ember rather than darkness. */
#define RING_BREATHE_MIN  80

/* --- Configuration --- */

#define RING_CFG_FILE     "/ring.json"
#define RING_CFG_TMP      "/ring.tmp"

/* host-test:begin consts — sliced out by tools/test_quiet.sh */
/* Settings arrive on the web-server task; the flash write is deferred to
   loop(), the one task allowed to spend milliseconds. Same arrangement, and the
   same reason, as the notification store's snapshot. */
#define RING_CFG_DELAY_MS 1500

#define RING_BRIGHT_DEFAULT     50
#define RING_NIGHT_FROM_DEFAULT 0        /* 00:00 */
#define RING_NIGHT_TO_DEFAULT   (8 * 60) /* 08:00 */
/* host-test:end */

#define RING_TEST_MAX_S   60
#define RING_TEST_DEF_S   8

/* --- Palette ---
 *
 * The three level colours are the RGB888 equivalents of the RGB565 the clock
 * face already uses (COL_INFO, COL_ACCENT, COL_CRIT), so that a message which
 * is amber on the screen is the same amber on the ring rather than a second
 * opinion about what "warn" looks like. Green belongs to acknowledgement only
 * and appears nowhere else in the UI. */

struct RingColor { uint8_t r, g, b; };

static const RingColor RING_C_INFO = { 41, 239, 173};  /* teal   <- COL_INFO   */
static const RingColor RING_C_WARN = {255, 162,  41};  /* amber  <- COL_ACCENT */
static const RingColor RING_C_CRIT = {230,  57,  41};  /* red    <- COL_CRIT   */
static const RingColor RING_C_ACK  = { 60, 220,  80};  /* green, acknowledge   */
static const RingColor RING_C_OFF  = {  0,   0,   0};

static const RingColor &ring_level_color(uint8_t level) {
    switch (level) {
        case NOTIFY_CRIT: return RING_C_CRIT;
        case NOTIFY_WARN: return RING_C_WARN;
        default:          return RING_C_INFO;
    }
}

/* pow(i / 255, 2.6) * 255, rounded. 2.6 is the exponent Adafruit's LED work
   settled on for WS2812 parts and it is what makes a linear envelope look
   linear. 256 bytes of flash. */
static const uint8_t ring_gamma[256] = {
      0,   0,   0,   0,   0,   0,   0,   0,   0,   0,   0,   0,   0,   0,   0,   0,
      0,   0,   0,   0,   0,   0,   0,   0,   1,   1,   1,   1,   1,   1,   1,   1,
      1,   1,   1,   1,   2,   2,   2,   2,   2,   2,   2,   2,   3,   3,   3,   3,
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    218, 220, 223, 225, 227, 230, 232, 235, 237, 240, 242, 245, 247, 250, 252, 255,
};

/* --- State --- */

static bool ring_ready = false;
static uint8_t ring_blocks = 0;          /* memory blocks the channel actually got */

/* host-test:begin settings — sliced out by tools/test_quiet.sh */
/* Everything the endpoints can write is volatile: those handlers run on the
   web-server task while ring_poll() reads the same words on the loop task. All
   of them are single aligned scalars, so the worst a collision can cost is one
   frame composed from a half-applied setting — 25ms of the old brightness. */
static volatile bool ring_enabled = true;
static volatile uint8_t ring_brightness = RING_BRIGHT_DEFAULT;   /* percent, 0..100 */
static volatile uint16_t ring_night_from = RING_NIGHT_FROM_DEFAULT;
static volatile uint16_t ring_night_to = RING_NIGHT_TO_DEFAULT;

/* The window the silence was last switched off from, and the only copy of it:
   switching off empties the live pair above, and this device has no way to type
   a time back in. Empty here means nothing has been remembered yet, which is
   the same encoding the live window uses for "no silence" — see
   ring_night_is_window(). Both are persisted, so a reboot restores the schedule and
   not just the fact that there was one. */
static volatile uint16_t ring_night_saved_from = 0;
static volatile uint16_t ring_night_saved_to = 0;

static volatile bool ring_cfg_dirty = false;
static volatile unsigned long ring_cfg_save_at = 0;
/* host-test:end */

/* One-shot overlays. Only one can run at a time: they are all half a second
   long and stacking them would say nothing a single one does not. */
enum { RING_FX_NONE = 0, RING_FX_COMET, RING_FX_WIPE };
static volatile uint8_t ring_fx = RING_FX_NONE;
static volatile uint8_t ring_fx_level = NOTIFY_INFO;
static volatile unsigned long ring_fx_start = 0;

/* Knob tracking. ui_poll() hands over each detent; the position is free-running
   modulo the ring so that turning past the last pixel arrives at the first,
   exactly as the menu wraps rather than clamps. */
static int ring_knob_pos = 0;
static unsigned long ring_knob_at = 0;

/* Progress, 0..100, or -1 for "no job". Fed from loop() with whichever job
   skills/progress.cpp has arbitrated onto the bar, so the arc and the bar are
   the same job by construction rather than by two suppliers agreeing. Nothing
   that publishes progress knows this exists. */
static int ring_progress_pct = -1;

/* Test pattern, so colours can be judged without inventing a notification. */
enum { RING_TEST_NONE = 0, RING_TEST_BREATHE, RING_TEST_LEVELS };
static volatile uint8_t ring_test = RING_TEST_NONE;
static volatile uint8_t ring_test_level = NOTIFY_INFO;
static volatile unsigned long ring_test_until = 0;

/* GRB bytes as they go on the wire, and the last set the peripheral accepted. */
static uint8_t ring_frame[RING_LEDS][3];
static uint8_t ring_sent[RING_LEDS][3];
static bool ring_sent_valid = false;

/* 768 bytes, in .bss rather than on the loop task's stack. */
static rmt_data_t ring_sym[RING_BITS];

/* --- Colour maths --- */

/* One channel of one pixel: perceptual scale, gamma encode, then the linear
   cap. See the header comment for why that order and not another. */
static uint8_t ring_level(uint8_t channel, uint8_t envelope) {
    uint16_t perceptual = ((uint16_t)channel * envelope) / 255;
    return (uint8_t)(((uint16_t)ring_gamma[perceptual] * ring_brightness) / 100);
}

static void ring_put(uint8_t frame[RING_LEDS][3], int i, const RingColor &c,
                     uint8_t envelope) {
    if (i < 0 || i >= RING_LEDS) return;
    frame[i][0] = ring_level(c.g, envelope);   /* WS2812 takes GRB on the wire */
    frame[i][1] = ring_level(c.r, envelope);
    frame[i][2] = ring_level(c.b, envelope);
}

/* 0 -> 255 -> 0 across cycle_ms, phased on the wall clock rather than on the
   effect's start, so that a ring which changes colour mid-breath continues the
   breath instead of restarting it. */
static uint8_t ring_triangle(unsigned long now, unsigned long cycle_ms) {
    unsigned long pos = now % cycle_ms;
    unsigned long half = cycle_ms / 2;
    unsigned long up = (pos < half) ? pos : (cycle_ms - pos);
    return (uint8_t)(up * 255 / half);
}

/* --- Night window ---
 *
 * The window is two numbers and a rule, and all three are pure — which is why
 * they are sliced out below and held to account on the host by
 * tools/test_quiet.sh. Only ring_night_now() needs the clock, and it is the one
 * thing here that is not testable.
 *
 * Keep every marker line self-closed and on a line of its own: the slicer drops
 * the marker and copies what follows verbatim, without understanding it. And
 * keep the tags from being prefixes of one another — the slicer matches a tag
 * as a substring, so a region tagged `quietload` would also be pulled in by
 * every request for `quiet`, and the copy lands in the generated file twice.
 * That is why the stored-document region below is tagged `stored`.
 */

/* host-test:begin quiet — sliced out by tools/test_quiet.sh */
/* The live window and the one it can be brought back from. They travel as a
   pair because every decision below reads both: switching the silence on and
   off is nothing but moving hours between them, and the whole point is that no
   step of it invents an hour or drops one. */
struct RingQuiet {
    uint16_t from, to;              /* the live window, minutes from midnight */
    uint16_t saved_from, saved_to;  /* the window the toggle switched off */
};

/* Do these two boundaries describe a window at all? from == to describes none,
   which is how the silence is turned off without a fourth setting — and it is
   also how the saved pair spells "nothing remembered", one encoding for "no
   window" rather than two. Asks a question; sets nothing. */
static bool ring_night_is_window(uint16_t from, uint16_t to) {
    return from != to;
}

/* Is `minutes` past midnight inside the window? from > to wraps midnight, which
   is the shape most people actually want (22:00 to 07:00). The start is
   inclusive and the end exclusive, so an 08:00 end makes 08:00 the first minute
   of the morning rather than the last of the night. */
static bool ring_night_holds(uint16_t from, uint16_t to, int minutes) {
    if (!ring_night_is_window(from, to)) return false;
    if (from < to) return minutes >= from && minutes < to;
    return minutes >= from || minutes < to;
}

/*
 * Keep the restore point in step with the live window.
 *
 * Called wherever the window is set — the menu toggle, POST /ring, the config
 * load — so that switching the silence off remembers the hours that were in
 * force a moment earlier rather than the ones somebody set last week. An empty
 * window is never remembered: it is the state being switched away from, and
 * recording it would erase the only copy of the schedule.
 */
static void ring_quiet_keep(RingQuiet &q) {
    if (!ring_night_is_window(q.from, q.to)) return;
    q.saved_from = q.from;
    q.saved_to = q.to;
}

/*
 * Switch the silence on or off without losing the hours.
 *
 * Off collapses the live window onto its own start, which ring_night_holds()
 * reads as "no silence" — but it remembers the hours first, because this device
 * has no time entry of any kind and hours erased here cannot be typed back in.
 *
 * On with nothing remembered takes the compiled defaults, and that case is real
 * rather than theoretical: a device whose stored window was already empty
 * before the saved pair existed comes up with nothing to restore. 00:00-08:00
 * is the firmware's own default and it is wrong in the harmless direction — a
 * night that is too long gets noticed and changed, while a toggle that appears
 * to do nothing reads as broken.
 */
static void ring_quiet_switch(RingQuiet &q, bool on,
                              uint16_t def_from, uint16_t def_to) {
    if (!on) {
        ring_quiet_keep(q);
        q.to = q.from;
        return;
    }
    if (!ring_night_is_window(q.saved_from, q.saved_to)) {
        q.saved_from = def_from;
        q.saved_to = def_to;
    }
    q.from = q.saved_from;
    q.to = q.saved_to;
}

/*
 * The whole silence rule with the clock reading lifted out of it: a window that
 * exists, a clock that has been set, and a minute inside the window.
 *
 * `clock_set` false stays LIT, deliberately, and it is a parameter here rather
 * than a call so that the choice is a testable one. A node that has not reached
 * NTP is usually a freshly booted or offline one, and a pager that goes dark
 * because it lost the time fails in the direction that loses messages. See the
 * header.
 */
static bool ring_night_active(uint16_t from, uint16_t to, bool clock_set,
                              int minutes) {
    if (!clock_set) return false;
    return ring_night_holds(from, to, minutes);
}
/* host-test:end */

/* Is there a window at all? The clock face and the menu row both ask, and it is
   the same question the silence rule asks first. */
static bool ring_night_armed() {
    return ring_night_is_window(ring_night_from, ring_night_to);
}

static bool ring_night_now() {
    /* The early return is a saved clock read and nothing else — with no window
       ring_night_active() answers false for any minute and any clock. It is
       here because ring_compose() asks this forty times a second. */
    if (!ring_night_armed()) return false;
    struct tm t;
    bool clock_set = clock_local_time(t);
    return ring_night_active(ring_night_from, ring_night_to, clock_set,
                             clock_set ? t.tm_hour * 60 + t.tm_min : 0);
}

/* --- Effect triggers (called from loop(), ui.h and the endpoints) --- */

/*
 * Start a one-shot overlay, stamped with the caller's own clock reading.
 *
 * `now` is a parameter rather than a millis() call for the same reason
 * ring_compose() takes one: ring_poll() samples the time once and every
 * decision in that pass has to be made against that one sample. Stamping here
 * with a fresh millis() made ring_fx_start LATER than the `now` the retirement
 * checks below compare it to, and `now - ring_fx_start` is unsigned — so a
 * single millisecond of drift underflowed to about 4.29 billion, cleared
 * RING_COMET_MS instantly and cancelled the arrival comet on the very pass it
 * was fired. ring_cfg_save() sits between the two in ring_poll() and is a
 * SPIFFS write of several milliseconds, so any pass where a deferred settings
 * save met an arrival lost its comet outright; without a save it was a
 * millisecond race that silently dropped a fraction of them.
 *
 * The endpoint calls this from the web-server task, where there is no such
 * sample and millis() is the only honest answer — which is why the comparisons
 * are also signed. A stamp from that task can still land after ring_poll()
 * read its clock, and signed arithmetic reads that as a small negative age
 * rather than an enormous positive one.
 */
static void ring_fire(uint8_t fx, uint8_t level, unsigned long now) {
    ring_fx = fx;
    ring_fx_level = level;
    ring_fx_start = now;
}

static void ring_knob(int steps) {
    if (steps == 0) return;
    ring_knob_pos = (ring_knob_pos + steps) % RING_LEDS;
    if (ring_knob_pos < 0) ring_knob_pos += RING_LEDS;
    ring_knob_at = millis();
}

static void ring_progress_set(int pct) {
    if (pct < 0) pct = 0;
    if (pct > 100) pct = 100;
    ring_progress_pct = pct;
}

static void ring_progress_clear() {
    ring_progress_pct = -1;
}

/* --- Frame composition ---
 *
 * Priority, highest first:
 *
 *   knob      a hand is on the control; that hand's feedback outranks anything
 *             the ring was saying on its own
 *   test      an operator asked for this pattern explicitly
 *   one-shot  arrival or acknowledgement, half a second each
 *   dark      nothing to say
 *
 * and then, at the bottom, two claimants with no fixed order between them:
 *
 *   progress  a job is running and its position is the information
 *   breathe   unread messages exist
 *
 * Against an unread info or warn the progress arc simply wins. Against an
 * unread CRITICAL the two alternate, the critical taking the whole ring and the
 * longer phase — the rule and the reason live in progress_ring_phase() in
 * skills/progress.cpp, because that is where somebody tempted to remove it will
 * be reading.
 *
 * `now` is passed in rather than read here: ring_poll() retires expired effects
 * against one timestamp, and composing against a second one taken microseconds
 * later would let an effect be drawn one millisecond past its own end — which
 * for the wipe's fade is the difference between reaching zero and wrapping past
 * it to full brightness.
 */
static void ring_compose(uint8_t frame[RING_LEDS][3], unsigned long now) {
    memset(frame, 0, RING_LEDS * 3);

    /* Disabled, or inside the night window: composed dark and pushed once, so
       the ring goes out rather than freezing on its last frame. */
    if (!ring_enabled || ring_night_now()) return;

    if (now - ring_knob_at < RING_KNOB_HOLD_MS) {
        ring_put(frame, ring_knob_pos, RING_C_WARN, 255);
        return;
    }

    if (ring_test != RING_TEST_NONE) {
        if (ring_test == RING_TEST_LEVELS) {
            /* Two pixels each with a gap between, so the three can be compared
               side by side at whatever brightness is currently set. */
            ring_put(frame, 0, RING_C_INFO, 255);
            ring_put(frame, 1, RING_C_INFO, 255);
            ring_put(frame, 3, RING_C_WARN, 255);
            ring_put(frame, 4, RING_C_WARN, 255);
            ring_put(frame, 6, RING_C_CRIT, 255);
            ring_put(frame, 7, RING_C_CRIT, 255);
        } else {
            uint8_t env = RING_BREATHE_MIN +
                          (uint8_t)((255 - RING_BREATHE_MIN) *
                                    ring_triangle(now, RING_BREATHE_MS) / 255);
            for (int i = 0; i < RING_LEDS; i++)
                ring_put(frame, i, ring_level_color(ring_test_level), env);
        }
        return;
    }

    if (ring_fx == RING_FX_COMET) {
        /* Clamped rather than trusted: the endpoint can stamp ring_fx_start
           from the web-server task after this pass sampled `now`, and an
           unsigned difference would turn those few milliseconds into an
           enormous elapsed time. The modulo below bounds the damage to a wrong
           pixel, but a comet that starts at zero is the correct answer. */
        unsigned long el = now - ring_fx_start;
        if ((long)el < 0) el = 0;
        int head = (int)(el * RING_LEDS / RING_COMET_MS);
        const RingColor &c = ring_level_color(ring_fx_level);
        /* Head at full, then a tail that falls away behind it. The tail is what
           makes the lap read as a direction rather than a chase of blinks. */
        static const uint8_t tail[RING_COMET_TAIL + 1] = {255, 110, 45, 15};
        for (int t = 0; t <= RING_COMET_TAIL; t++) {
            int p = head - t;
            if (p < 0) p += RING_LEDS;
            ring_put(frame, p % RING_LEDS, c, tail[t]);
        }
        return;
    }

    if (ring_fx == RING_FX_WIPE) {
        unsigned long el = now - ring_fx_start;   /* see the comet above */
        if ((long)el < 0) el = 0;
        unsigned long fill_ms = RING_WIPE_MS - RING_WIPE_FADE_MS;
        int lit = (int)(el * RING_LEDS / fill_ms);
        if (lit > RING_LEDS) lit = RING_LEDS;
        uint8_t env = 255;
        if (el > fill_ms) {
            unsigned long f = el - fill_ms;
            if (f > RING_WIPE_FADE_MS) f = RING_WIPE_FADE_MS;
            env = (uint8_t)(255 - (f * 255 / RING_WIPE_FADE_MS));
        }
        for (int i = 0; i < lit; i++) ring_put(frame, i, RING_C_ACK, env);
        return;
    }

    /* The last two claimants do not have a fixed order between them. A progress
       arc beats an unread info or warn outright — those are already on the
       clock face as the amber dot and the count — but against an unread
       CRITICAL it takes turns, and the shorter turn. The ring is the channel
       that is readable from across a room, and a critical message must never
       be outbid on it; see progress_ring_phase() in skills/progress.cpp for why
       the two phases are deliberately unequal and must stay that way.

       One acquisition of the notification lock serves both decisions, which is
       also why the level is read here rather than by asking twice. */
    uint8_t top;
    bool unread = notify_top_unread_level(top);
    bool crit = unread && top == NOTIFY_CRIT;

    if (progress_ring_phase(crit, ring_progress_pct >= 0, now) == PROGRESS_RING_ARC) {
        /* The lit arc is the progress. The pixel at the boundary carries the
           fraction, so eight LEDs read as rather more than eight steps, and it
           never goes fully dark while a job is running — a blast that has not
           yet sent its first frame is still a blast, and an unlit ring would
           say the opposite. */
        int scaled = ring_progress_pct * RING_LEDS;         /* 0..800 */
        int whole = scaled / 100;
        int part = scaled % 100;
        for (int i = 0; i < whole && i < RING_LEDS; i++)
            ring_put(frame, i, RING_C_WARN, 255);
        if (whole < RING_LEDS) {
            int env = part * 255 / 100;
            if (env < 40) env = 40;
            ring_put(frame, whole, RING_C_WARN, (uint8_t)env);
        }
        return;
    }

    /* Either nothing is running, or the critical has the ring for this phase.
       Both land here, and both want the same breathe. */
    if (unread) {
        unsigned long cycle = (top == NOTIFY_CRIT) ? RING_BREATHE_CRIT_MS
                                                   : RING_BREATHE_MS;
        uint8_t env = RING_BREATHE_MIN +
                      (uint8_t)((255 - RING_BREATHE_MIN) *
                                ring_triangle(now, cycle) / 255);
        for (int i = 0; i < RING_LEDS; i++)
            ring_put(frame, i, ring_level_color(top), env);
    }
}

/* --- Transmission --- */

static void ring_encode() {
    const uint8_t *bytes = &ring_frame[0][0];
    int s = 0;
    for (int b = 0; b < RING_LEDS * 3; b++) {
        uint8_t v = bytes[b];
        for (int bit = 7; bit >= 0; bit--) {
            bool one = (v >> bit) & 1;
            ring_sym[s].level0 = 1;
            ring_sym[s].duration0 = one ? RING_T1H : RING_T0H;
            ring_sym[s].level1 = 0;
            ring_sym[s].duration1 = one ? RING_T1L : RING_T0L;
            s++;
        }
    }
}

/* --- Persistence --- */

static void ring_cfg_save() {
    JsonDocument doc;
    doc["on"] = ring_enabled;
    doc["b"] = ring_brightness;
    doc["nf"] = ring_night_from;
    doc["nt"] = ring_night_to;
    /* The window the toggle would restore. Saved next to the live one and not
       derived from it, because the two are only equal while the silence is on —
       the moment it is switched off the live pair is empty and this is the only
       record of the hours left anywhere on the device. */
    doc["qf"] = ring_night_saved_from;
    doc["qt"] = ring_night_saved_to;
    String out;
    serializeJson(doc, out);
    write_spiffs_file_atomic(RING_CFG_FILE, RING_CFG_TMP, out);
}

/* host-test:begin pair — sliced out by tools/test_quiet.sh */
static void ring_cfg_mark_dirty() {
    unsigned long at = millis() + RING_CFG_DELAY_MS;
    if (!ring_cfg_dirty || (long)(at - ring_cfg_save_at) < 0) ring_cfg_save_at = at;
    ring_cfg_dirty = true;
}

/* The four window words as one struct and back again. Everything that changes
   the window works on a copy and writes it back in one place, for the reason
   the POST handler already gives about its own locals: a change that is half
   applied is worse than one that is refused, and here the half that could go
   missing is the schedule itself.

   Both halves run on either task. The words are single aligned scalars, so the
   worst a collision costs is one frame or one response composed from a
   half-applied window — the same trade every setting in this file makes. */
static void ring_quiet_read(RingQuiet &q) {
    q.from = ring_night_from;
    q.to = ring_night_to;
    q.saved_from = ring_night_saved_from;
    q.saved_to = ring_night_saved_to;
}

/*
 * Put a pair back, and say whether anything actually moved.
 *
 * Applying and SCHEDULING THE FLASH WRITE are two jobs, and this one does only
 * the first — the caller marks. That split is not tidiness: a helper that also
 * marked rewrote /ring.json on every single power-on. The load path applies a
 * pair that came out of the file, and ring_quiet_restore() finishes by deriving
 * the restore point from the live window, so the pair it hands back differs
 * from the words it started with for a stored empty window, for a document
 * identical to the compiled defaults, and for one that says nothing at all. One
 * erase cycle per boot on a battery device, against the erase budget
 * notify.cpp's own snapshot argues for at NOTIFY_PERSIST.
 *
 * The two places somebody actually changes the window — the menu toggle and
 * POST /ring — both read this answer and mark from it.
 */
static bool ring_quiet_apply(const RingQuiet &q) {
    bool changed = (q.from != ring_night_from) || (q.to != ring_night_to) ||
                   (q.saved_from != ring_night_saved_from) ||
                   (q.saved_to != ring_night_saved_to);
    ring_night_from = q.from;
    ring_night_to = q.to;
    ring_night_saved_from = q.saved_from;
    ring_night_saved_to = q.saved_to;
    return changed;
}
/* host-test:end */

/* host-test:begin stored — sliced out by tools/test_quiet.sh */
/*
 * Both windows out of one stored settings document.
 *
 * `q` comes in holding what the firmware would have without a file at all — the
 * compiled defaults — and a field that is absent, of the wrong type or out of
 * range simply leaves that half of it standing. Ranges are checked rather than
 * trusted for the reason notify_snapshot_restore() gives about its own fields:
 * a stored file is not a more trustworthy source than a request body, since
 * this filesystem can be replaced wholesale by anyone who can write an image.
 *
 * EVERY FILE ON EVERY DEVICE TODAY WAS WRITTEN WITHOUT qf/qt, so what happens
 * to them is not an edge case, it is the next boot everywhere. Spelled out:
 *
 *   - qf/qt missing entirely -> the saved pair keeps what it came in with,
 *     which is 0/0, "nothing remembered". It is NOT invented from the live
 *     window's boundaries by some default, because a device that has never had
 *     a schedule must not appear to have one.
 *
 *   - qf/qt present but equal -> the same thing, and deliberately
 *     indistinguishable from missing. An empty pair IS "nothing remembered" —
 *     one encoding, as ring_night_is_window() says — and giving a stored empty
 *     pair a second meaning would be a fourth state to reason about for no gain.
 *
 *   - a live window that IS set -> ring_quiet_keep() below adopts it as the
 *     restore point. This is what carries an upgrading device across: a file
 *     with nf/nt 22:00-07:00 and no qf/qt comes up able to switch off and back
 *     on, rather than with a schedule it can only destroy once.
 *
 *   - a live window that is NOT set and nothing remembered — the state the
 *     owner's own device is in tonight, its window switched off over the
 *     network before this firmware existed — leaves the pair empty. The toggle
 *     then has nothing to restore, and ring_quiet_switch() takes
 *     RING_NIGHT_FROM_DEFAULT/RING_NIGHT_TO_DEFAULT: 00:00-08:00 appears. That
 *     is stated there and it is a decision, not a `| 0` falling out of a parse.
 */
static void ring_quiet_restore(JsonObjectConst o, RingQuiet &q) {
    if (o["nf"].is<int>() && o["nt"].is<int>()) {
        int f = o["nf"].as<int>(), t = o["nt"].as<int>();
        if (f >= 0 && f < 1440 && t >= 0 && t < 1440) {
            q.from = (uint16_t)f;
            q.to = (uint16_t)t;
        }
    }
    if (o["qf"].is<int>() && o["qt"].is<int>()) {
        int f = o["qf"].as<int>(), t = o["qt"].as<int>();
        if (f >= 0 && f < 1440 && t >= 0 && t < 1440) {
            q.saved_from = (uint16_t)f;
            q.saved_to = (uint16_t)t;
        }
    }
    ring_quiet_keep(q);
}
/* host-test:end */

/* host-test:begin docapply — sliced out by tools/test_quiet.sh */
/*
 * A stored settings document over the live words.
 *
 * Everything ring_cfg_load() does once the file is read and parsed, and it is
 * its own function so that the one rule it has to keep is testable on the host:
 * NOTHING HERE SCHEDULES A WRITE. What came out of the file is already in the
 * file, and the pair ring_quiet_restore() hands back differs from the words it
 * started with on very nearly every document — see ring_quiet_apply(). A boot
 * that marked the config dirty cost an erase cycle every power-on.
 */
static void ring_cfg_apply_doc(JsonObjectConst o) {
    if (o["on"].is<bool>()) ring_enabled = o["on"].as<bool>();
    if (o["b"].is<int>()) {
        int b = o["b"].as<int>();
        if (b >= 0 && b <= 100) ring_brightness = (uint8_t)b;
    }
    /* Read into a copy of the live pair and written back in one place, so that
       a file carrying half a window cannot leave half of one behind. The answer
       — did anything move — is dropped here on purpose, and only here. */
    RingQuiet q;
    ring_quiet_read(q);
    ring_quiet_restore(o, q);
    ring_quiet_apply(q);
}
/* host-test:end */

/* A file that is missing, truncated or nonsense leaves the compiled defaults
   standing: the ring is a notification channel, and the worst outcome of a bad
   config read is that it silently stops being one. */
static void ring_cfg_load() {
    String raw = read_spiffs_file(RING_CFG_FILE);
    if (raw.length() == 0) return;
    JsonDocument doc;
    if (deserializeJson(doc, raw) != DeserializationError::Ok) return;
    ring_cfg_apply_doc(doc.as<JsonObjectConst>());
}

/* --- Poll --- */

static const char *ring_effect_name() {
    if (!ring_ready) return "unavailable";
    if (!ring_enabled) return "disabled";
    if (ring_night_now()) return "night";
    /* Signed: this one reports on the web-server task while ring_knob() stamps
       on the loop task, so the stamp can be newer than the reading. Unsigned,
       that underflowed and reported anything but "knob" during the one
       response where the knob had just moved. */
    if ((long)(millis() - ring_knob_at) < (long)RING_KNOB_HOLD_MS) return "knob";
    if (ring_test == RING_TEST_LEVELS) return "test-levels";
    if (ring_test == RING_TEST_BREATHE) return "test-breathe";
    if (ring_fx == RING_FX_COMET) return "comet";
    if (ring_fx == RING_FX_WIPE) return "wipe";
    /* The same two-claimant decision ring_compose() makes, against a clock read
       here rather than passed in: this reports on the web-server task, and what
       it should report is what the ring is doing at the moment of the request.
       While a critical alternates with a job this therefore flips between
       "progress" and "breathe" from one GET to the next, which is the honest
       answer rather than a confusing one. */
    uint8_t top;
    bool unread = notify_top_unread_level(top);
    bool crit = unread && top == NOTIFY_CRIT;
    if (progress_ring_phase(crit, ring_progress_pct >= 0, millis()) == PROGRESS_RING_ARC)
        return "progress";
    if (unread) return "breathe";
    return "idle";
}

/* Called every loop() pass; does real work RING_FRAME_MS apart at most. */
static void ring_poll() {
    if (!ring_ready) return;

    unsigned long now = millis();
    static unsigned long last_frame = 0;
    if (now - last_frame < RING_FRAME_MS) return;
    last_frame = now;

    if (ring_cfg_dirty && (long)(now - ring_cfg_save_at) >= 0) {
        ring_cfg_dirty = false;
        ring_cfg_save();
    }

    /* Arrivals and acknowledgements are consumed whatever the ring is doing —
       including while it is disabled or silenced — so that a night's worth of
       them cannot queue up and all fire at eight in the morning. Both flags are
       taken every pass and the arrival wins the frame; leaving the other one
       standing would show it a moment later, on top of whatever came next. */
    uint8_t level;
    bool acked = notify_take_ring_ack();
    if (notify_take_ring_arrival(&level)) ring_fire(RING_FX_COMET, level, now);
    else if (acked) ring_fire(RING_FX_WIPE, NOTIFY_INFO, now);

    /* Signed, so an effect fired from the web-server task after this pass read
       its clock reads as not-yet-started instead of as 4.29 billion
       milliseconds old. See ring_fire(). */
    if (ring_fx == RING_FX_COMET && (long)(now - ring_fx_start) >= (long)RING_COMET_MS)
        ring_fx = RING_FX_NONE;
    if (ring_fx == RING_FX_WIPE && (long)(now - ring_fx_start) >= (long)RING_WIPE_MS)
        ring_fx = RING_FX_NONE;
    if (ring_test != RING_TEST_NONE && (long)(now - ring_test_until) >= 0)
        ring_test = RING_TEST_NONE;

    uint8_t want[RING_LEDS][3];
    ring_compose(want, now);

    if (ring_sent_valid && memcmp(want, ring_sent, sizeof(want)) == 0) return;

    /* The peripheral reads ring_sym asynchronously after rmtWriteAsync(), so
       the buffer must not be rewritten until it says it is finished. At 230us
       of transmission against a 25ms frame this never fires in practice; it is
       here because "never in practice" is not the same as "never". */
    if (!rmtTransmitCompleted(PIN_WS2812)) return;

    memcpy(ring_frame, want, sizeof(ring_frame));
    ring_encode();
    if (rmtWriteAsync(PIN_WS2812, ring_sym, RING_BITS)) {
        memcpy(ring_sent, want, sizeof(ring_sent));
        ring_sent_valid = true;
    }
}

/* --- Endpoints --- */

static const SkillEndpoint ring_endpoints[] = {
    {"GET",  "/ring",      "Ring state and settings: brightness, night window and the one it restores, current effect"},
    {"POST", "/ring",      "Set {enabled, brightness, night_from, night_to} — any subset"},
    {"POST", "/ring/test", "Show a pattern {effect, level, seconds} without queueing a message"},
    {NULL, NULL, NULL}
};

static const char *ring_describe() {
    return "## Skill: ring\n\n"
           "The 8-LED WS2812 ring around the encoder (GPIO14), driven by the\n"
           "RMT peripheral on its own TX channel. It is the pager's second\n"
           "output: the screen says what happened, the ring says that something\n"
           "happened, from across a room.\n\n"
           "### Endpoints\n\n"
           "| Method | Path | Description |\n"
           "|--------|------|-------------|\n"
           "| GET | /ring | `{\"enabled\":true,\"brightness\":50,\"night_from\":\"00:00\",\"night_to\":\"08:00\",\"night_on\":true,\"night_saved_from\":\"00:00\",\"night_saved_to\":\"08:00\",\"night_now\":false,\"clock_set\":true,\"effect\":\"breathe\",\"level\":\"warn\",\"unread\":2}` |\n"
           "| POST | /ring | `{\"enabled\":true,\"brightness\":35,\"night_from\":\"23:30\",\"night_to\":\"07:00\"}` — every field optional |\n"
           "| POST | /ring/test | `{\"effect\":\"levels\"\\|\"breathe\"\\|\"comet\"\\|\"wipe\"\\|\"off\",\"level\":\"warn\",\"seconds\":8}` |\n\n"
           "A POST that names a setting it cannot parse changes nothing at all,\n"
           "rather than applying the fields it understood. Window boundaries\n"
           "take `\"HH:MM\"` with two digits each, or minutes past midnight.\n\n"
           "### What it shows\n\n"
           "While any message is unread the ring **breathes** in the colour of\n"
           "the most severe one — teal for info, amber for warn, red for crit,\n"
           "the same three the screen uses — and it keeps breathing until they\n"
           "are acknowledged. That is a state, not a flash: it is what tells you\n"
           "there is something waiting when you are not looking at the panel.\n\n"
           "On top of that: a comet lap when a message arrives, in that\n"
           "message's colour; a green wipe when one is acknowledged; an amber\n"
           "dot that follows the knob while you turn it; and, while a long job\n"
           "runs, a lit arc that is the job's progress. That arc is whichever\n"
           "job the progress skill has picked, so it always agrees with the bar\n"
           "on the clock face; nothing that publishes progress knows the ring\n"
           "exists.\n\n"
           "While a `crit` is unacknowledged the ring alternates between the\n"
           "red breathe and that arc — six seconds of red, three of arc — with\n"
           "the red deliberately given the longer phase. This is the channel\n"
           "you read from across a room, where the colour is the whole message,\n"
           "and a critical must not be outbid on it by a percentage. Unread\n"
           "info and warn do not alternate; a running job simply wins, because\n"
           "those are already on the clock face as the dot and the count.\n\n"
           "### Brightness\n\n"
           "`brightness` is a percentage, 0 to 100, applied to every pixel as a\n"
           "linear cap on drive current. It defaults to 50 and is meant to be\n"
           "dialled in live against the actual room rather than guessed at; the\n"
           "value survives a reboot.\n\n"
           "Colours are gamma-corrected (2.6) before the cap. Without that a\n"
           "breath looks like a snap to full followed by a plateau, and at the\n"
           "bottom of the ramp teal and amber both turn to grey.\n\n"
           "### Night silence\n\n"
           "Between `night_from` and `night_to` the ring does not light at all —\n"
           "including for a critical, which already breathes on the screen, and\n"
           "including a test pattern, which reports `suppressed` rather than\n"
           "lighting. Times are local, taken from the POSIX TZ string in\n"
           "`POST /clock/tz`; this skill knows no city and no offset. Set the\n"
           "two boundaries equal to switch the silence off. A window whose start\n"
           "is later than its end wraps midnight, so `23:30`-`07:00` is the\n"
           "night you would expect.\n\n"
           "If the clock has never been set the ring stays lit: a node that has\n"
           "not reached NTP is usually a freshly booted one, and going dark\n"
           "because the time is unknown fails in the direction that loses\n"
           "messages. `clock_set` in `GET /ring` says which of the two a\n"
           "`night_now` of false means — window open, or no window yet — so a\n"
           "ring lit at 3am can be diagnosed over the API.\n\n"
           "### Switching the silence off, and getting it back\n\n"
           "The window is also a switch on the device itself: the **Quiet** row\n"
           "in the on-screen menu turns it on and off from the knob, which is\n"
           "the only way to do it with no network in reach. Because switching\n"
           "off means setting the two boundaries equal, and this device has no\n"
           "way to type a time in, the hours are remembered rather than erased.\n\n"
           "`GET /ring` therefore carries three fields beyond the boundaries:\n"
           "`night_on` (false exactly when they are equal), and\n"
           "`night_saved_from` / `night_saved_to`, the window a switch back on\n"
           "would restore. The saved pair follows every window set through this\n"
           "endpoint too, so a schedule pushed over the API is what the knob\n"
           "brings back. If nothing has ever been remembered — the saved pair is\n"
           "equal — switching on takes the firmware's own `00:00`-`08:00`.\n\n"
           "This is a schedule and nothing else. There is no \"be quiet for the\n"
           "next hour\": two boundaries cannot express one, and the toggle does\n"
           "not pretend otherwise.\n\n"
           "### Example\n\n"
           "```\n"
           "curl -H \"Authorization: Bearer $TOKEN\" -H 'Content-Type: application/json' \\\n"
           "  -d '{\"brightness\":35,\"night_from\":\"23:30\",\"night_to\":\"07:00\"}' \\\n"
           "  http://seed.local:8080/ring\n"
           "curl -H \"Authorization: Bearer $TOKEN\" -H 'Content-Type: application/json' \\\n"
           "  -d '{\"effect\":\"levels\",\"seconds\":15}' http://seed.local:8080/ring/test\n"
           "```\n";
}

/* host-test:begin label — sliced out by tools/test_quiet.sh */
static void ring_time_str(uint16_t mins, char *out, size_t n) {
    snprintf(out, n, "%02u:%02u", (unsigned)(mins / 60), (unsigned)(mins % 60));
}

/* The menu row's text. It carries the hours rather than just "on", so the row
   answers when as well as whether — this device has no other screen that could,
   and the hours are exactly what a toggle without a memory would have lost.

   It takes a window rather than reading the live words, which is what lets it
   be sliced onto the host: it is the only user-facing string this release adds,
   the width argument at its call site in ui.h counts these exact characters,
   and formatting somebody reads at one in the morning should not be the one
   thing here with no test. */
static void ring_quiet_label(uint16_t from, uint16_t to, char *out, size_t n) {
    if (!ring_night_is_window(from, to)) {
        snprintf(out, n, "Quiet off");
        return;
    }
    char f[8], t[8];
    ring_time_str(from, f, sizeof(f));
    ring_time_str(to, t, sizeof(t));
    snprintf(out, n, "Quiet %s-%s", f, t);
}
/* host-test:end */

/* --- The toggle, as the front panel works it ---
 *
 * Until now the window could only be changed over the network, which is no use
 * at a desk at one in the morning with the pager sitting there silent. These two
 * are what the menu row in ui.h is made of, and they are here rather than there
 * for the same reason progress_status_line() is in its own skill: the UI draws,
 * the skill owns the state and formats the string.
 */

/* Flip the silence and report where it landed. The event line names the hours
   either way — switched on, they are what the device will be silent for;
   switched off, they are what a second click gets back. */
static bool ring_quiet_toggle() {
    RingQuiet q;
    ring_quiet_read(q);
    bool on = !ring_night_is_window(q.from, q.to);
    ring_quiet_switch(q, on, RING_NIGHT_FROM_DEFAULT, RING_NIGHT_TO_DEFAULT);
    if (ring_quiet_apply(q)) ring_cfg_mark_dirty();
    event_add("ring: quiet %s (%02u:%02u-%02u:%02u)", on ? "on" : "off, kept",
              (unsigned)(q.saved_from / 60), (unsigned)(q.saved_from % 60),
              (unsigned)(q.saved_to / 60), (unsigned)(q.saved_to % 60));
    return on;
}

/* Accepts "HH:MM" or a plain minute count, because one of those is what a
   person types and the other is what a script already has.
 *
 * Parsed by hand rather than with sscanf(): nothing else in this firmware calls
 * the scanf family, and linking it in for five characters costs roughly 25KB of
 * flash. Five characters exactly — "8:30" is rejected rather than guessed at,
 * which also makes the format that comes back out the only one accepted. */
static bool ring_parse_time(JsonVariantConst v, uint16_t &out) {
    if (v.is<const char *>()) {
        const char *s = v.as<const char *>();
        if (!s || strlen(s) != 5 || s[2] != ':') return false;
        for (int i = 0; i < 5; i++) {
            if (i == 2) continue;
            if (s[i] < '0' || s[i] > '9') return false;
        }
        int h = (s[0] - '0') * 10 + (s[1] - '0');
        int m = (s[3] - '0') * 10 + (s[4] - '0');
        if (h > 23 || m > 59) return false;
        out = (uint16_t)(h * 60 + m);
        return true;
    }
    if (v.is<int>()) {
        int m = v.as<int>();
        if (m < 0 || m > 1439) return false;
        out = (uint16_t)m;
        return true;
    }
    return false;
}

static void ring_state_json(JsonDocument &doc) {
    char from[8], to[8];
    ring_time_str(ring_night_from, from, sizeof(from));
    ring_time_str(ring_night_to, to, sizeof(to));

    doc["ready"] = ring_ready;
    doc["leds"] = RING_LEDS;
    doc["pin"] = PIN_WS2812;
    doc["mem_blocks"] = ring_blocks;
    doc["enabled"] = ring_enabled;
    doc["brightness"] = ring_brightness;
    doc["night_from"] = from;
    doc["night_to"] = to;
    /* The toggle's own two answers, which the two boundaries above no longer
       carry on their own now that switching off keeps the hours somewhere.
       `night_on` is the state the menu row shows, and the saved pair is what a
       switch back on would restore — an empty one means nothing has been
       remembered yet and the compiled defaults would be taken instead. */
    doc["night_on"] = ring_night_armed();
    char saved_from[8], saved_to[8];
    ring_time_str(ring_night_saved_from, saved_from, sizeof(saved_from));
    ring_time_str(ring_night_saved_to, saved_to, sizeof(saved_to));
    doc["night_saved_from"] = saved_from;
    doc["night_saved_to"] = saved_to;
    doc["night_now"] = ring_night_now();
    /* Without this, `night_now: false` covers two different situations — the
       window is open, or the clock has never been set and there is no window at
       all. We deliberately stay lit in the second case, so a ring breathing at
       3am is correct behaviour rather than a bug, and this is what makes that
       diagnosable without standing in front of the device. */
    struct tm probe;
    doc["clock_set"] = clock_local_time(probe);
    doc["effect"] = ring_effect_name();
    doc["unread"] = notify_unread_count();
    uint8_t top;
    if (notify_top_unread_level(top)) doc["level"] = notify_level_name(top);
    if (ring_progress_pct >= 0) doc["progress"] = ring_progress_pct;
}

/* notify_take_body() and notify_send_error() are notify.cpp's, reused rather
   than copied: the skills are #included into one translation unit, and a third
   identical pair of four-line JSON helpers would be three too many. Every route
   below is registered with AsyncURIMatcher::exact(), without which /ring would
   also answer /ring/test and every test request would be read as a settings
   change with no body. */
static void ring_register_routes(AsyncWebServer &server) {

    server.on(AsyncURIMatcher::exact("/ring"), HTTP_GET, [](AsyncWebServerRequest *req) {
        if (!require_auth(req)) return;
        JsonDocument doc;
        ring_state_json(doc);
        String out;
        serializeJson(doc, out);
        req->send(200, "application/json", out);
    });

    /* Bodies are collected by handle_body_collect() into _tempObject and belong
       to the handler from then on, including on the unauthenticated path —
       hence check_auth() rather than require_auth()'s early return. */
    server.on(AsyncURIMatcher::exact("/ring"), HTTP_POST, [](AsyncWebServerRequest *req) {
        char *body = notify_take_body(req);
        if (!check_auth(req)) {
            free(body);
            notify_send_error(req, 401, "Authorization: Bearer <token> required");
            return;
        }
        if (!body) {
            notify_send_error(req, 400, "body must be JSON");
            return;
        }
        JsonDocument input;
        DeserializationError err = deserializeJson(input, body);
        free(body);
        if (err != DeserializationError::Ok) {
            notify_send_error(req, 400, "invalid JSON");
            return;
        }

        /* Parsed into locals first: a body that names four settings and gets
           one of them wrong applies none of them, rather than half. */
        bool enabled = ring_enabled;
        uint8_t brightness = ring_brightness;
        uint16_t from = ring_night_from, to = ring_night_to;

        if (input["enabled"].is<bool>()) enabled = input["enabled"].as<bool>();
        else if (!input["enabled"].isNull()) {
            notify_send_error(req, 400, "enabled must be true or false");
            return;
        }
        if (input["brightness"].is<int>()) {
            int b = input["brightness"].as<int>();
            if (b < 0 || b > 100) {
                notify_send_error(req, 400, "brightness must be 0..100 (percent)");
                return;
            }
            brightness = (uint8_t)b;
        } else if (!input["brightness"].isNull()) {
            notify_send_error(req, 400, "brightness must be a number, 0..100");
            return;
        }
        if (!input["night_from"].isNull() &&
            !ring_parse_time(input["night_from"], from)) {
            notify_send_error(req, 400, "night_from must be \"HH:MM\" or minutes past midnight");
            return;
        }
        if (!input["night_to"].isNull() &&
            !ring_parse_time(input["night_to"], to)) {
            notify_send_error(req, 400, "night_to must be \"HH:MM\" or minutes past midnight");
            return;
        }

        /* One predicate for the whole request, built as the change is applied.
           The two settings are compared here and the four window words are
           compared by ring_quiet_apply(), which is the only thing that can see
           the restore point move — a body that shifts the window but not the
           hours the toggle would bring back still has something to write, and a
           predicate written out here could not say so. */
        bool changed = (enabled != ring_enabled) || (brightness != ring_brightness);
        ring_enabled = enabled;
        ring_brightness = brightness;
        /* The restore point follows whatever window is set here, so that the
           menu toggle brings back the schedule this device was last actually
           keeping — set over the network or not — rather than the hours it was
           given the last time somebody stood in front of it. */
        RingQuiet q;
        ring_quiet_read(q);
        q.from = from;
        q.to = to;
        ring_quiet_keep(q);
        if (ring_quiet_apply(q)) changed = true;
        if (changed) {
            ring_cfg_mark_dirty();
            event_add("ring: %s, brightness %u%%, quiet %02u:%02u-%02u:%02u",
                      ring_enabled ? "on" : "off", (unsigned)ring_brightness,
                      (unsigned)(ring_night_from / 60), (unsigned)(ring_night_from % 60),
                      (unsigned)(ring_night_to / 60), (unsigned)(ring_night_to % 60));
        }

        JsonDocument doc;
        doc["ok"] = true;
        ring_state_json(doc);
        String out;
        serializeJson(doc, out);
        req->send(200, "application/json", out);
    }, NULL, handle_body_collect);

    server.on(AsyncURIMatcher::exact("/ring/test"), HTTP_POST, [](AsyncWebServerRequest *req) {
        char *body = notify_take_body(req);
        if (!check_auth(req)) {
            free(body);
            notify_send_error(req, 401, "Authorization: Bearer <token> required");
            return;
        }
        if (!body) {
            notify_send_error(req, 400, "body must be JSON with an effect");
            return;
        }
        JsonDocument input;
        DeserializationError err = deserializeJson(input, body);
        free(body);
        if (err != DeserializationError::Ok) {
            notify_send_error(req, 400, "invalid JSON");
            return;
        }

        const char *effect = input["effect"] | "levels";
        uint8_t level = NOTIFY_INFO;
        if (input["level"].is<const char *>() &&
            !notify_level_parse(input["level"].as<const char *>(), level)) {
            notify_send_error(req, 400, "level must be info, warn or crit");
            return;
        }
        int seconds = input["seconds"] | RING_TEST_DEF_S;
        if (seconds < 1 || seconds > RING_TEST_MAX_S) {
            notify_send_error(req, 400, "seconds must be 1..60");
            return;
        }

        if (strcmp(effect, "off") == 0) {
            ring_test = RING_TEST_NONE;
            ring_fx = RING_FX_NONE;
        } else if (strcmp(effect, "levels") == 0) {
            ring_test = RING_TEST_LEVELS;
            ring_test_until = millis() + (unsigned long)seconds * 1000UL;
        } else if (strcmp(effect, "breathe") == 0) {
            ring_test = RING_TEST_BREATHE;
            ring_test_level = level;
            ring_test_until = millis() + (unsigned long)seconds * 1000UL;
        } else if (strcmp(effect, "comet") == 0) {
            ring_test = RING_TEST_NONE;
            /* millis() here, not a shared sample: this runs on the web-server
               task, which has no frame of its own. ring_poll()'s comparisons
               are signed precisely so this stamp may be newer than theirs. */
            ring_fire(RING_FX_COMET, level, millis());
        } else if (strcmp(effect, "wipe") == 0) {
            ring_test = RING_TEST_NONE;
            ring_fire(RING_FX_WIPE, NOTIFY_INFO, millis());
        } else {
            notify_send_error(req, 400,
                              "effect must be levels, breathe, comet, wipe or off");
            return;
        }

        JsonDocument doc;
        doc["ok"] = true;
        doc["effect"] = effect;
        /* Said out loud rather than left as a mystery: the night window
           silences a test too, and the way out is the same API. */
        bool suppressed = !ring_ready || !ring_enabled || ring_night_now();
        doc["suppressed"] = suppressed;
        if (suppressed) {
            doc["reason"] = !ring_ready ? "ring unavailable"
                          : !ring_enabled ? "ring disabled"
                          : "inside the night window";
        }
        ring_state_json(doc);
        String out;
        serializeJson(doc, out);
        req->send(200, "application/json", out);
    }, NULL, handle_body_collect);
}

static const Skill ring_skill = {
    .name = "ring",
    .version = "0.1.0",
    .describe = ring_describe,
    .endpoints = ring_endpoints,
    .register_routes = ring_register_routes
};

/* Runs after skill_ir_init(), and the order is load-bearing: IR asks for two of
   the four TX memory blocks and must get them, so it allocates first and the
   ring takes what is left. Both channels are held for the life of the boot. */
static void skill_ring_init() {
    ring_cfg_load();

    /* Backdated so the very first frames are not read as "the knob was just
       turned". Unsigned wraparound makes this correct even when init runs
       before millis() has reached RING_KNOB_HOLD_MS. */
    ring_knob_at = millis() - RING_KNOB_HOLD_MS;

    /* 10MHz, so one duration tick is 100ns and the WS2812 bit cells above are
       whole numbers. Two memory blocks for interrupt-latency headroom, falling
       back to one rather than leaving the ring dark. */
    ring_blocks = 2;
    ring_ready = rmtInit(PIN_WS2812, RMT_TX_MODE, RMT_MEM_NUM_BLOCKS_2, 10000000);
    if (!ring_ready) {
        ring_blocks = 1;
        ring_ready = rmtInit(PIN_WS2812, RMT_TX_MODE, RMT_MEM_NUM_BLOCKS_1, 10000000);
    }
    if (!ring_ready) {
        ring_blocks = 0;
        event_add("ring: RMT init failed on pin %d", PIN_WS2812);
    } else {
        /* Idle low between frames: that gap is the WS2812 latch, and a line
           left high would be a permanent "reset never happened". */
        rmtSetEOT(PIN_WS2812, LOW);
        if (ring_blocks == 1)
            event_add("ring: only one RMT memory block available");
        /* The ring's state at reset is undefined, so the first frame is pushed
           unconditionally — ring_sent_valid is false and ring_poll() composes
           darkness on its first pass. */
    }

    skill_register(&ring_skill);
}
